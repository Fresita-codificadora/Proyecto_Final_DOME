-- WARNING: Do NOT edit the input and output ports in this file in a text
-- editor if you plan to continue editing the block that represents it in
-- the Block Editor! File corruption is VERY likely to occur.

-- Copyright (C) 2023  Intel Corporation. All rights reserved.
-- Your use of Intel Corporation's design tools, logic functions 
-- and other software and tools, and any partner logic 
-- functions, and any output files from any of the foregoing 
-- (including device programming or simulation files), and any 
-- associated documentation or information are expressly subject 
-- to the terms and conditions of the Intel Program License 
-- Subscription Agreement, the Intel Quartus Prime License Agreement,
-- the Intel FPGA IP License Agreement, or other applicable license
-- agreement, including, without limitation, that your use is for
-- the sole purpose of programming logic devices manufactured by
-- Intel and sold by Intel or its authorized distributors.  Please
-- refer to the applicable agreement for further details, at
-- https://fpgasoftware.intel.com/eula.


-- Generated by Quartus Prime Version 23.1 (Build Build 991 11/28/2023)
-- Created on Fri Nov 15 21:51:21 2024

FUNCTION access_ram (selector, data_1[(data_width-1)..0], addr_1[(addr_width-1)..0], r_w_1, addr_2[(addr_width-1)..0], r_w_2)
	WITH (addr_width, data_width)
	RETURNS (data_o[(data_width-1)..0], addr_o[(addr_width-1)..0], r_w_o);
